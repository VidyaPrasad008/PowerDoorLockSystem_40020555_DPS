AUTOSAR XML (schema 00050)
package /ARRoot
  ecu instance PowerDoorLockLeftECUInstance
    can communication controller DoorSystemLeftCanCommunicationController
    can communication connector DoorSystemLeftCanCommunicationConnector: comm-controller=DoorSystemLeftCanCommunicationController
  flat map PowerDoorLockLeftFlatMap: instances=flat-instance-descriptor=PowerDoorLockLeftSystem.PowerDoorLockLeftRootSoftwareComposition.PowerDoorLockLeft
  system PowerDoorLockLeftSystem
    system mapping PowerDoorLockLeftSoftwareMapping: client-server-to-signal-mapping=communication-direction=OUT
      sw-impl-mappings:
        swc to impl mapping PowerDoorLockLeftSwcToImpleMapping: component-implementation=PowerDoorLockImpFile, component=PowerDoorLockLeftRootSoftwareComposition.PowerDoorLockLeftSystemSwComponentProto.PowerDoorLockLeftSystemSwComponentProto
      sw-mappings:
        swc to ecu mapping PowerDoorLockLeftSwcToEcuMapping: component=PowerDoorLockLeftRootSoftwareComposition.PowerDoorLockLeftSystemSwComponentProto.PowerDoorLockLeftSystemSwComponentProto, controlled-hw-element=/ARRoot/, ecu-instance=PowerDoorLockLeftECUInstance, processing-unit=/ARRoot/
    root-software-compositions:
      root sw composition prototype PowerDoorLockLeftRootSoftwareComposition: flat-map=PowerDoorLockLeftFlatMap, software-composition=PowerDoorLockSystemLeftTopLevelComposition
  ecu instance PowerDoorLockRightECUInstance
    can communication controller DoorSystemRightCanCommunicationController
    can communication connector DoorSystemRightCanCommunicationConnector: comm-controller=DoorSystemRightCanCommunicationController
  flat map PowerDoorLockRightFlatMap: instances=flat-instance-descriptor=PowerDoorLockRightSystem.PowerDoorLockRightRootSoftwareComposition.PowerDoorLockRight
  system PowerDoorLockRightSystem
    system mapping PowerDoorLockRightSoftwareMapping: client-server-to-signal-mapping=communication-direction=OUT
      sw-impl-mappings:
        swc to impl mapping PowerDoorLockRightSwcToImpleMapping: component-implementation=PowerDoorLockImpFile, component=PowerDoorLockRightRootSoftwareComposition.PowerDoorLockRightSystemSwComponentProto.PowerDoorLockRightSystemSwComponentProto
      sw-mappings:
        swc to ecu mapping PowerDoorLockRightSwcToEcuMapping: component=PowerDoorLockRightRootSoftwareComposition.PowerDoorLockRightSystemSwComponentProto.PowerDoorLockRightSystemSwComponentProto, controlled-hw-element=/ARRoot/, ecu-instance=PowerDoorLockRightECUInstance, processing-unit=/ARRoot/
    root-software-compositions:
      root sw composition prototype PowerDoorLockRightRootSoftwareComposition: flat-map=PowerDoorLockRightFlatMap, software-composition=PowerDoorLockSystemLeftTopLevelComposition
  can cluster PowerDoorLockSystemLeftCanCluster
    can physical channel DoorSystemCanPhysicalChannel: comm-connectors=DoorSystemLeftCanCommunicationConnector
  composition sw component type PowerDoorLockSystemLeftTopLevelComposition
    component PowerDoorLockLeftSystemSwComponentProto: type=PowerDoorLockControllerType
    delegation sw connector PowerDoorLockConnectorProto: outer-port=PowerDoorLockLeft
  can cluster PowerDoorLockSystemRightCanCluster
    can physical channel DoorSystemCanPhysicalChannel: comm-connectors=DoorSystemRightCanCommunicationConnector
  composition sw component type PowerDoorLockSystemRightTopLevelComposition
    component PowerDoorLockRightSystemSwComponentProto: type=PowerDoorLockControllerType
    delegation sw connector PowerDoorLockConnectorProto: outer-port=PowerDoorLockRight
